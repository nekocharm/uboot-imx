## configs/mx6ull_mini_emmc_defconfig
```kconfig
CONFIG_SYS_EXTRA_OPTIONS="IMX_CONFIG=board/freescale/mx6ull_mini_emmc/imximage.cfg,MX6ULL_MINI_EMMC_REWORK"
CONFIG_ARM=y
CONFIG_ARCH_MX6=y
CONFIG_TARGET_MX6ULL_MINI_EMMC=y
CONFIG_CMD_GPIO=y
```
